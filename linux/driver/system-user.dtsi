/include/ "system-conf.dtsi"
/ {
   reserved-memory {
      #address-cells = <1>;
      #size-cells = <1>;
      ranges;
  
      reserved: map_fpga@0x40000000 {
         no-map;
         reg = <0x40000000 0xFFF 0x30000000 0xFF 0x43C00000 0xFFF>;
      };
   };
  
   fbga-driver@0 {
      compatible = "vendor,fbga_drv";
      interrupt-parent = <&intc>;
	  interrupts = <0 29 4>;
      memory-region = <&reserved>;
   };
};
